# file: projectSTM32f411.ioc
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Mcu.Family=STM32F4
Mcu.Name=STM32F411V(C-E)Tx
Mcu.Package=LQFP100
NVIC.PriorityGroup=NVIC_PRIORITYGROUP_4
PA13.Mode=Serial_Wire
PA13.Signal=SYS_JTMS-SWDIO
PA14.Mode=Serial_Wire
PA14.Signal=SYS_JTCK-SWCLK
ProjectManager.HeapSize=0x200
ProjectManager.StackSize=0x400
ProjectManager.TargetToolchain=STM32CubeIDE
RCC.AHBFreq_Value=16000000
RCC.APB1Freq_Value=16000000
RCC.APB2Freq_Value=16000000
RCC.CortexFreq_Value=16000000
RCC.HSE_VALUE=25000000
RCC.HSI_VALUE=16000000
RCC.LSE_VALUE=32768
RCC.SYSCLKFreq_VALUE=16000000
RCC.VCOOutputFreq_Value=192000000
board=custom

// file: Core/Src/main.c
/* USER CODE BEGIN Header */
/**
  ******************************************************************************
  * @file           : main.c
  * @brief          : Main program body
  ******************************************************************************
  * @attention
  *
  * Copyright (c) 2022 STMicroelectronics.
  * All rights reserved.
  *
  * This software is licensed under terms that can be found in the LICENSE file
  * in the root directory of this software component.
  * If no LICENSE file comes with this software, it is provided AS-IS.
  *
  ******************************************************************************
  */
/* USER CODE END Header */
#include <GPIO_Led.h>
#include <Button.h>
#include <UART2_CP2102.h>
#include <SPI1.h>
#include <I2C.h>
#include "main.h"
#include "gpio.h"

/* USER CODE BEGIN Includes */

#include <string.h>
/* USER CODE END Includes */

/* USER CODE BEGIN PTD */

//char receiveData[32] = {0};
int ledButton = 0;

//SPI
#define OUT_X_L 0x28
#define OUT_X_H 0x29
#define OUT_Y_L 0x2A
#define OUT_Y_H 0x2B
#define OUT_Z_L 0x2C
#define OUT_Z_H 0x2D
uint16_t x_data;
uint16_t y_data;
uint16_t z_data;

/* USER CODE END PTD */

void SystemClock_Config(void);

int main(void)
{

  /* MCU Configuration--------------------------------------------------------*/

  /* Reset of all peripherals, Initializes the Flash interface and the Systick. */
  HAL_Init();

  /* Configure the system clock */
  SystemClock_Config();

  /* Initialize all configured peripherals */
  MX_GPIO_Init();
  /* USER CODE BEGIN 2 */

  Led_Init();

  Button_Init();

  UART_Init();

  SPI1_Init();

  I2C_Init();

  /**
   //UART: send data
  char mess[] = "hello world\n";
  for (int i = 0; i < sizeof(mess) - 1; i++) {
	  UART_SendData(mess[i]);
  }

  //UART: receive data
  char receiveData[32] = {0};
  UART_ReadBytes(receiveData, 5, HAL_MAX_DELAY);
  **/

  /**
  //SPI
  const uint8_t WHO_AM_I = 0x0f;
  SPI1_SensorWrite(0x20, 0b00001111);
  **/

  //I2C
  const uint8_t WHO_AM_I = 0xf;
  const uint8_t addressSensor = 0b0011001;
  const uint8_t data = I2C_Read(addressSensor, WHO_AM_I);
//0011001 - 0xf
//0011110 - 0x4f

  /* USER CODE END 2 */

  /* Infinite loop */
  while (1)
  {
	  /**
	  //GPIO_Led
	  Led_Ctrl(LED_ON, LED_12);
	  HAL_Delay(1000);
	  Led_Ctrl(LED_OFF, LED_12);
	  HAL_Delay(1000);
	  **/
	  /**
	  //SPI1
	  uint8_t low = SPI1_SensorRead(OUT_X_L);
	  uint8_t high = SPI1_SensorRead(OUT_X_H);
	  x_data = (high << 8) | low;

	  low = SPI1_SensorRead(OUT_Y_L);
	  high = SPI1_SensorRead(OUT_Y_H);
	  y_data = (high << 8) | low;

	  low = SPI1_SensorRead(OUT_Z_L);
	  high = SPI1_SensorRead(OUT_Z_H);
	  z_data = (high << 8) | low;

	  HAL_Delay(1000);
	  **/

  }
}

void SystemClock_Config(void)
{
  RCC_OscInitTypeDef RCC_OscInitStruct = {0};
  RCC_ClkInitTypeDef RCC_ClkInitStruct = {0};

  /** Configure the main internal regulator output voltage
  */
  __HAL_RCC_PWR_CLK_ENABLE();
  __HAL_PWR_VOLTAGESCALING_CONFIG(PWR_REGULATOR_VOLTAGE_SCALE1);

  /** Initializes the RCC Oscillators according to the specified parameters
  * in the RCC_OscInitTypeDef structure.
  */
  RCC_OscInitStruct.OscillatorType = RCC_OSCILLATORTYPE_HSI;
  RCC_OscInitStruct.HSIState = RCC_HSI_ON;
  RCC_OscInitStruct.HSICalibrationValue = RCC_HSICALIBRATION_DEFAULT;
  RCC_OscInitStruct.PLL.PLLState = RCC_PLL_NONE;
  if (HAL_RCC_OscConfig(&RCC_OscInitStruct) != HAL_OK)
  {
    Error_Handler();
  }

  /** Initializes the CPU, AHB and APB buses clocks
  */
  RCC_ClkInitStruct.ClockType = RCC_CLOCKTYPE_HCLK|RCC_CLOCKTYPE_SYSCLK
                              |RCC_CLOCKTYPE_PCLK1|RCC_CLOCKTYPE_PCLK2;
  RCC_ClkInitStruct.SYSCLKSource = RCC_SYSCLKSOURCE_HSI;
  RCC_ClkInitStruct.AHBCLKDivider = RCC_SYSCLK_DIV1;
  RCC_ClkInitStruct.APB1CLKDivider = RCC_HCLK_DIV1;
  RCC_ClkInitStruct.APB2CLKDivider = RCC_HCLK_DIV1;

  if (HAL_RCC_ClockConfig(&RCC_ClkInitStruct, FLASH_LATENCY_0) != HAL_OK)
  {
    Error_Handler();
  }
}

void Error_Handler(void)
{
  __disable_irq();
  while (1)
  {
  }
}
